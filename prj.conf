## CMakeLists.txt
```
cmake_minimum_required(VERSION 3.20.0)

# Set DTS_ROOT so Zephyr finds our custom devicetree bindings in dts/bindings/
list(APPEND DTS_ROOT ${CMAKE_CURRENT_SOURCE_DIR})

# Explicitly specify the overlay file
set(DTC_OVERLAY_FILE ${CMAKE_CURRENT_SOURCE_DIR}/app.overlay)

find_package(Zephyr REQUIRED HINTS $ENV{ZEPHYR_BASE})

project(liftsense_firmware)

target_sources(app PRIVATE 
    src/main.c
    src/imu.c
    src/ble.c
    src/sensor_math.c
    src/battery.c
)
```

## west.yml
```
manifest:
  version: 0.10

  projects:
    - name: zephyr
      url: https://github.com/zephyrproject-rtos/zephyr
      revision: main
      import: true
```

## prj.conf
```kconfig
#CONFIG_SERIAL=y
#CONFIG_CONSOLE=y
#CONFIG_PRINTK=y
#CONFIG_UART_CONSOLE=y

# Console
CONFIG_STDOUT_CONSOLE=y
CONFIG_PRINTK=y

# IMU Sensor
CONFIG_I2C=y
CONFIG_SENSOR=y
CONFIG_LSM6DSL_TRIGGER_GLOBAL_THREAD=y
CONFIG_CBPRINTF_FP_SUPPORT=y

# BLE
CONFIG_BT=y
CONFIG_BT_PERIPHERAL=y
CONFIG_BT_DEVICE_NAME="LiftSense"

# Battery Management
CONFIG_GPIO=y
CONFIG_ADC=y
```

## app.overlay
```dts
/ {
	xiao_ble_battery_dev: xiao_ble_battery_dev {
		compatible = "xiao-ble-battery";
		charging-enable-gpios = <&gpio0 17 GPIO_ACTIVE_LOW>;
		read-enable-gpios = <&gpio0 14 GPIO_ACTIVE_LOW>;
		charge-speed-gpios = <&gpio0 13 GPIO_ACTIVE_LOW>;
		adc-channel = <NRF_SAADC_AIN7>;
	};
};
```

## dts/bindings/xiao-ble-battery.yaml
```yaml
description: binding for XIAO BLE Battery Management

compatible: "xiao-ble-battery"

properties:
  charging-enable-gpios:
    type: phandle-array
    required: true
    description: GPIO used to enable charging

  read-enable-gpios:
    type: phandle-array
    required: true
    description: GPIO used to enable the readout of the charging voltage

  charge-speed-gpios:
    type: phandle-array
    required: true
    description: GPIO used to select the charging speed (high = 100mA, low = 50mA)

  adc-input-id:
    type: int
    default: 7
    description: ADC channel id

  adc-gain:
    type: int
    default: 0
    description: ADC channel gain factor. ADC-reference * 6 = 3.6V

  adc-reference:
    type: int
    default: 4
    description: ADC reference. usually 0.6V.

  adc-channel:
    type: int
    required: true
    description: ADC channel to read out the battery voltage. Usually AIN7.

  adc-channel-id:
    type: int
    default: 7
    description: ADC channel to read out the battery voltage

  adc-resolution:
    type: int
    default: 12
    description: ADC resolution

  adc-sample-interval:
    type: int
    default: 500
    description: defines the time between each sample in [us].

  adc-total-samples:
    type: int
    default: 10
    description: |
      Change this to a higher number for better averages
      Note that increasing this holds up the thread / ADC for longer.

  adc-filtering-algorithm:
    type: string
    default: "average"
    description: ADC sample filtering algorithm
    enum:
      - "average"
      - "trimmed-mean"

  adc-acquisition-time:
    type: int
    default: 0
    description: ADC Acquisition time

  battery-callbacks-max:
    type: int
    default: 3
    description: Defines the number of battery callbacks.
```

## src/main.c
```c
#include <zephyr/kernel.h>
#include <zephyr/sys/printk.h>
#include <zephyr/drivers/sensor.h>
#include <stdio.h>

#include "imu.h"
#include "ble.h"
#include "sensor_math.h"
#include "imu_packet.h"
#include "battery.h"

static struct imu_packet imu_data;
static uint32_t last_filter_time_ms;

/* Battery sample callback - updates BLE Battery Service */
static void battery_sample_handler(uint16_t millivolt)
{
    uint8_t percentage;
    int ret = battery_get_percentage(&percentage, millivolt);
    if (ret == 0) {
        ble_update_battery_level(percentage);
        printk("Battery: %d mV (%d%%)\n", millivolt, percentage);
    }
}

int main(void)
{
    printk("LiftSense firmware booting...\n");

    /* Initialize IMU */
    if (imu_init() < 0) {
        return -1;
    }

    /* Initialize BLE */
    if (ble_init() < 0) {
        return -1;
    }

    /* Start BLE advertising */
    if (ble_start_advertising() < 0) {
        return -1;
    }

    /* Set up IMU trigger */
    if (imu_setup_trigger(NULL) < 0) {
        return -1;
    }

    /* Initialize battery management */
    if (battery_init() == 0) {
        /* Register callback for battery samples */
        battery_register_sample_callback(battery_sample_handler);
        
        /* Start periodic battery sampling every 30 seconds */
        battery_start_sampling(30000);
    } else {
        printk("Battery init failed - continuing without battery monitoring\n");
    }

    /* Calibrate gravity vector */
    double gx, gy, gz;
    double gravity_magnitude = imu_calibrate_gravity(&gx, &gy, &gz);
    
    /* Initialize sensor math module */
    sensor_math_init(gx, gy, gz, gravity_magnitude);
    last_filter_time_ms = k_uptime_get_32();

    printk("LiftSense streaming started\n");
    printk("BLE Packet Format (18 bytes, little-endian):\n");
    printk("  [0-3]   timestamp_ms (uint32_t)\n");
    printk("  [4-5]   ax (int16_t, m/s² × 1000)\n");
    printk("  [6-7]   ay (int16_t, m/s² × 1000)\n");
    printk("  [8-9]   az (int16_t, m/s² × 1000)\n");
    printk("  [10-11] gx (int16_t, dps × 1000)\n");
    printk("  [12-13] gy (int16_t, dps × 1000)\n");
    printk("  [14-15] gz (int16_t, dps × 1000)\n");
    printk("  [16-17] vertical (int16_t, m/s² × 1000)\n");
    printk("\n");

    while (1) {
        struct sensor_value accel_x, accel_y, accel_z;
        struct sensor_value gyro_x, gyro_y, gyro_z;
        
        /* Get current sensor values */
        imu_get_values(&accel_x, &accel_y, &accel_z,
                      &gyro_x, &gyro_y, &gyro_z);
        
        double ax_d = sensor_value_to_double(&accel_x);
        double ay_d = sensor_value_to_double(&accel_y);
        double az_d = sensor_value_to_double(&accel_z);
        double gx_d = sensor_value_to_double(&gyro_x);
        double gy_d = sensor_value_to_double(&gyro_y);
        double gz_d = sensor_value_to_double(&gyro_z);
        
        /* Update complementary filter */
        uint32_t current_time_ms = k_uptime_get_32();
        double dt = (current_time_ms - last_filter_time_ms) / 1000.0;
        if (dt > 0.001 && dt < 1.0) {  /* Sanity check */
            sensor_math_update_filter(ax_d, ay_d, az_d, gx_d, gy_d, gz_d, dt);
        }
        last_filter_time_ms = current_time_ms;
        
        /* Pack IMU data for BLE transmission */
        imu_data.timestamp_ms = current_time_ms;
        imu_data.ax = sensor_to_milli_int16(&accel_x);
        imu_data.ay = sensor_to_milli_int16(&accel_y);
        imu_data.az = sensor_to_milli_int16(&accel_z);
        imu_data.gx = sensor_to_milli_int16(&gyro_x);
        imu_data.gy = sensor_to_milli_int16(&gyro_y);
        imu_data.gz = sensor_to_milli_int16(&gyro_z);
        
        /* Calculate vertical acceleration */
        double vertical_accel = sensor_math_calc_vertical(ax_d, ay_d, az_d);
        imu_data.vertical = (int16_t)(vertical_accel * 1000.0);

        /* Send BLE notification if enabled */
        if (ble_is_notify_enabled()) {
            ble_notify_imu_data(&imu_data);
        }

        /* Print to console for debugging */
        double grav_x, grav_y, grav_z;
        sensor_math_get_gravity_estimate(&grav_x, &grav_y, &grav_z);
        
        printf("CONSOLE: Accel: x=%.2f y=%.2f z=%.2f m/s² | "
               "Gyro: x=%.2f y=%.2f z=%.2f dps | "
               "Vert: %.2f m/s² | Grav: [%.2f,%.2f,%.2f]\n",
               ax_d, ay_d, az_d,
               gx_d, gy_d, gz_d,
               imu_data.vertical / 1000.0,
               grav_x, grav_y, grav_z);
        
        /* Also print as int16 millis to match BLE format */
        printk("PACKED:  ts=%u ax=%d ay=%d az=%d gx=%d gy=%d gz=%d vert=%d\n",
               imu_data.timestamp_ms,
               imu_data.ax, imu_data.ay, imu_data.az,
               imu_data.gx, imu_data.gy, imu_data.gz,
               imu_data.vertical);

        k_sleep(K_MSEC(20));  /* 50 Hz streaming rate */
    }
    
    return 0;
}
```

## src/battery.c
```c
/*
 * Copyright 2024 Marcus Alexander Tjomsaas
 * SPDX-License-Identifier: Apache-2.0
 * 
 * Adapted for LiftSense project
 */

#include "battery.h"

#include <zephyr/kernel.h>
#include <zephyr/device.h>
#include <zephyr/devicetree.h>
#include <zephyr/drivers/gpio.h>
#include <zephyr/drivers/adc.h>
#include <zephyr/sys/printk.h>

#if !DT_NODE_EXISTS(DT_NODELABEL(xiao_ble_battery_dev))
#error "Overlay for xiao_ble_battery_dev node not properly defined."
#endif

#define BATTERY_NODE DT_NODELABEL(xiao_ble_battery_dev)
#define BATTERY_CALLBACK_MAX DT_PROP(BATTERY_NODE, battery_callbacks_max)
#define ADC_TOTAL_SAMPLES DT_PROP(BATTERY_NODE, adc_total_samples)

//--------------------------------------------------------------
// ADC setup

#define ADC_FILTERING_ALGORITHM_AVERAGE      0
#define ADC_FILTERING_ALGORITHM_TRIMMED_MEAN 1

#define ADC_RESOLUTION          DT_PROP(BATTERY_NODE, adc_resolution)
#define ADC_CHANNEL             DT_PROP(BATTERY_NODE, adc_channel_id)
#define ADC_PORT                DT_PROP(BATTERY_NODE, adc_channel)
#define ADC_REFERENCE           DT_PROP(BATTERY_NODE, adc_reference)
#define ADC_GAIN                DT_PROP(BATTERY_NODE, adc_gain)
#define ADC_SAMPLE_INTERVAL_US  DT_PROP(BATTERY_NODE, adc_sample_interval)
#define ADC_ACQUISITION_TIME    DT_PROP(BATTERY_NODE, adc_acquisition_time)
#define ADC_FILTERING_ALGORITHM DT_ENUM_IDX(BATTERY_NODE, adc_filtering_algorithm)

#if ADC_FILTERING_ALGORITHM == ADC_FILTERING_ALGORITHM_TRIMMED_MEAN
#include <stdlib.h>
#endif

static struct adc_channel_cfg channel_7_cfg = {
    .gain = ADC_GAIN,
    .reference = ADC_REFERENCE,
    .acquisition_time = ADC_ACQUISITION_TIME,
    .channel_id = ADC_CHANNEL,
#ifdef CONFIG_ADC_NRFX_SAADC
    .input_positive = ADC_PORT
#endif
};

static struct adc_sequence_options options = {
    .extra_samplings = ADC_TOTAL_SAMPLES - 1,
    .interval_us = ADC_SAMPLE_INTERVAL_US,
};

static int16_t sample_buffer[ADC_TOTAL_SAMPLES];
static struct adc_sequence sequence = {
    .options = &options,
    .channels = BIT(ADC_CHANNEL),
    .buffer = sample_buffer,
    .buffer_size = sizeof(sample_buffer),
    .resolution = ADC_RESOLUTION,
};

//--------------------------------------------------------------
// Local variables

static const struct device *adc_battery_dev = DEVICE_DT_GET(DT_NODELABEL(adc));

static const struct gpio_dt_spec charging_enable = GPIO_DT_SPEC_GET_OR(BATTERY_NODE, charging_enable_gpios, {0});
static const struct gpio_dt_spec read_enable = GPIO_DT_SPEC_GET_OR(BATTERY_NODE, read_enable_gpios, {0});
static const struct gpio_dt_spec charge_speed = GPIO_DT_SPEC_GET_OR(BATTERY_NODE, charge_speed_gpios, {0});

static struct k_work_delayable sample_periodic_work;
static struct k_work sample_once_work;

static struct gpio_callback charging_callback;
static struct k_work charging_interrupt_work;

static battery_charging_callback_t charging_callbacks[BATTERY_CALLBACK_MAX];
static size_t charging_callbacks_registered = 0;

static battery_sample_callback_t sample_ready_callback[BATTERY_CALLBACK_MAX];
static size_t sample_ready_callbacks_registered = 0;

static uint32_t sampling_interval_ms;
static uint8_t is_initialized = false;

static K_MUTEX_DEFINE(battery_mut);

typedef struct
{
    uint16_t voltage;
    uint8_t percentage;
} BatteryState;

#define BATTERY_STATES_COUNT 11
// Voltage levels in millivolts and corresponding percentages for a typical LiPo battery
static BatteryState battery_states[BATTERY_STATES_COUNT] = {
    {4200, 100}, // Fully charged
    {4110, 90},
    {4020, 80},
    {3930, 70},
    {3840, 60},
    {3750, 50},
    {3660, 40},
    {3570, 30},
    {3480, 20},
    {3390, 10},
    {3300, 0} // Minimum safe voltage
};

//------------------------------------------------------------------------------------------
// Private functions

static int battery_enable_read()
{
    return gpio_pin_set_dt(&read_enable, 1);
}

static void run_charging_callbacks(struct k_work *work)
{
    bool is_charging = battery_is_charging();
    printk("Battery: Charger %s\n", is_charging ? "connected" : "disconnected");

    for (uint8_t callback = 0; callback < charging_callbacks_registered; callback++)
    {
        charging_callbacks[callback](is_charging);
    }
}

static void run_sample_ready_callbacks(uint32_t millivolt)
{
    for (uint8_t callback = 0; callback < sample_ready_callbacks_registered; callback++)
    {
        sample_ready_callback[callback](millivolt);
    }
}

static void charging_callback_handler(const struct device *dev,
                                      struct gpio_callback *cb,
                                      uint32_t pins)
{
    k_work_submit(&charging_interrupt_work);
}

static void sample_periodic_handler(struct k_work *work)
{
    uint16_t millivolt;
    int ret = battery_get_millivolt(&millivolt);
    if (ret)
    {
        printk("Battery: Failed to get voltage\n");
        goto reschedule;
    }

    run_sample_ready_callbacks(millivolt);

reschedule:
    k_work_reschedule(&sample_periodic_work, K_MSEC(sampling_interval_ms));
}

static void sample_once_handler(struct k_work *work)
{
    uint16_t millivolt;
    int ret = battery_get_millivolt(&millivolt);
    if (ret)
    {
        printk("Battery: Failed to get voltage\n");
        return;
    }

    run_sample_ready_callbacks(millivolt);
}

#if ADC_FILTERING_ALGORITHM == ADC_FILTERING_ALGORITHM_TRIMMED_MEAN
static int sample_buffer_compare(const void *a, const void *b)
{
    return (*(int16_t *)a - *(int16_t *)b);
}
#endif

//------------------------------------------------------------------------------------------
// Public functions

int battery_register_charging_callback(battery_charging_callback_t callback)
{
    if (charging_callbacks_registered == BATTERY_CALLBACK_MAX)
    {
        printk("Battery: Max callbacks reached\n");
        return -ENOMEM;
    }

    charging_callbacks[charging_callbacks_registered++] = callback;
    return 0;
}

int battery_register_sample_callback(battery_sample_callback_t callback)
{
    if (sample_ready_callbacks_registered == BATTERY_CALLBACK_MAX)
    {
        printk("Battery: Max callbacks reached\n");
        return -ENOMEM;
    }

    sample_ready_callback[sample_ready_callbacks_registered++] = callback;
    return 0;
}

int battery_set_fast_charge()
{
    if (!is_initialized)
    {
        return -ECANCELED;
    }

    return gpio_pin_set_dt(&charge_speed, 1); // FAST charge 100mA
}

int battery_set_slow_charge()
{
    if (!is_initialized)
    {
        return -ECANCELED;
    }

    return gpio_pin_set_dt(&charge_speed, 0); // SLOW charge 50mA
}

int battery_get_millivolt(uint16_t *battery_millivolt)
{
    int ret = 0;

    // Voltage divider circuit (calibrated values)
    const uint16_t R1 = 1037; // 1M ohm (calibrated)
    const uint16_t R2 = 510;  // 510K ohm

    uint16_t adc_vref = adc_ref_internal(adc_battery_dev);

    ret = k_mutex_lock(&battery_mut, K_SECONDS(10));
    if (ret < 0)
    {
        printk("Battery: Mutex locked\n");
        return ret;
    }

    ret |= adc_read(adc_battery_dev, &sequence);

    if (ret)
    {
        printk("Battery: ADC read failed (error %d)\n", ret);
    }

    uint32_t adc_sum = 0;
#if ADC_FILTERING_ALGORITHM == ADC_FILTERING_ALGORITHM_TRIMMED_MEAN
    // Get 25% trimmed mean sample value
    qsort(sample_buffer, ADC_TOTAL_SAMPLES, sizeof(int16_t), sample_buffer_compare);
    for (uint8_t sample = ADC_TOTAL_SAMPLES / 4; sample < ADC_TOTAL_SAMPLES / 4 + ADC_TOTAL_SAMPLES / 2; sample++)
    {
        adc_sum += sample_buffer[sample];
    }
    uint32_t adc_average = adc_sum / (ADC_TOTAL_SAMPLES / 2);
#else
    // Get average sample value
    for (uint8_t sample = 0; sample < ADC_TOTAL_SAMPLES; sample++)
    {
        adc_sum += sample_buffer[sample];
    }
    uint32_t adc_average = adc_sum / ADC_TOTAL_SAMPLES;
#endif

    // Convert ADC value to millivolts
    uint32_t adc_mv = adc_average;
    ret |= adc_raw_to_millivolts(adc_vref, ADC_GAIN, ADC_RESOLUTION, &adc_mv);

    // Calculate battery voltage
    float scale_factor = ((float)(R1 + R2)) / R2;
    *battery_millivolt = (uint16_t)(adc_mv * scale_factor);

    k_mutex_unlock(&battery_mut);

    return ret;
}

int battery_get_percentage(uint8_t *battery_percentage, uint16_t battery_millivolt)
{
    // Ensure voltage is within bounds
    if (battery_millivolt >= battery_states[0].voltage)
    {
        *battery_percentage = 100;
        return 0;
    }
    else if (battery_millivolt <= battery_states[BATTERY_STATES_COUNT - 1].voltage)
    {
        *battery_percentage = 0;
        return 0;
    }

    for (uint16_t i = 0; i < BATTERY_STATES_COUNT - 1; i++)
    {
        uint16_t voltage_high = battery_states[i].voltage;
        uint16_t voltage_low = battery_states[i + 1].voltage;

        // Find the two points between which battery_millivolt lies
        if (battery_millivolt <= voltage_high && battery_millivolt >= voltage_low)
        {
            uint8_t percentage_high = battery_states[i].percentage;
            uint8_t percentage_low = battery_states[i + 1].percentage;

            int32_t voltage_range = voltage_high - voltage_low;
            int32_t percentage_range = percentage_high - percentage_low;
            int32_t voltage_diff = battery_millivolt - voltage_low;

            if (voltage_range == 0)
            {
                *battery_percentage = percentage_high;
            }
            else
            {
                *battery_percentage = percentage_low + (voltage_diff * percentage_range) / voltage_range;
            }

            return 0;
        }
    }

    return -ESPIPE;
}

int battery_start_sampling(uint32_t interval_ms)
{
    if (interval_ms == 0)
    {
        printk("Battery: Interval must be > 0\n");
        return -EINVAL;
    }

    sampling_interval_ms = interval_ms;
    k_work_schedule(&sample_periodic_work, K_MSEC(interval_ms));

    printk("Battery: Sampling every %d ms\n", interval_ms);
    return 0;
}

int battery_stop_sampling(void)
{
    k_work_cancel_delayable(&sample_periodic_work);
    printk("Battery: Stopped sampling\n");
    return 0;
}

int battery_sample_once(void)
{
    k_work_submit(&sample_once_work);
    return 0;
}

bool battery_is_charging(void)
{
    return gpio_pin_get_dt(&charging_enable);
}

int battery_init()
{
    int ret = 0;

    // ADC setup
    if (!device_is_ready(adc_battery_dev))
    {
        printk("Battery: ADC device not found\n");
        return -EIO;
    }

    ret |= adc_channel_setup(adc_battery_dev, &channel_7_cfg);
    if (ret)
    {
        printk("Battery: ADC setup failed (error %d)\n", ret);
        return ret;
    }

    // GPIO setup
    if (!gpio_is_ready_dt(&charging_enable))
    {
        printk("Battery: GPIO charging_enable not found\n");
        return -EIO;
    }

    if (!gpio_is_ready_dt(&read_enable))
    {
        printk("Battery: GPIO read_enable not found\n");
        return -EIO;
    }

    if (!gpio_is_ready_dt(&charge_speed))
    {
        printk("Battery: GPIO charge_speed not found\n");
        return -EIO;
    }

    ret |= gpio_pin_configure_dt(&charging_enable, GPIO_INPUT | GPIO_ACTIVE_LOW);
    if (ret)
    {
        printk("Battery: Failed to configure charging_enable (error %d)\n", ret);
        return ret;
    }

    ret |= gpio_pin_interrupt_configure_dt(&charging_enable, GPIO_INT_EDGE_BOTH);
    if (ret)
    {
        printk("Battery: Failed to configure interrupt (error %d)\n", ret);
        return ret;
    }

    ret |= gpio_pin_configure_dt(&read_enable, GPIO_OUTPUT | GPIO_ACTIVE_LOW);
    if (ret)
    {
        printk("Battery: Failed to configure read_enable (error %d)\n", ret);
        return ret;
    }
    
    ret |= gpio_pin_configure_dt(&charge_speed, GPIO_OUTPUT | GPIO_ACTIVE_LOW);
    if (ret)
    {
        printk("Battery: Failed to configure charge_speed (error %d)\n", ret);
        return ret;
    }

    // Battery workers
    k_work_init_delayable(&sample_periodic_work, sample_periodic_handler);
    k_work_init(&sample_once_work, sample_once_handler);

    // Charger interrupt setup
    k_work_init(&charging_interrupt_work, run_charging_callbacks);
    gpio_init_callback(&charging_callback, charging_callback_handler,
                       BIT(charging_enable.pin));
    gpio_add_callback_dt(&charging_enable, &charging_callback);

    // Check current charging status
    bool is_charging = battery_is_charging();
    printk("Battery: Charger %s\n", is_charging ? "connected" : "disconnected");

    is_initialized = true;
    printk("Battery: Initialized\n");

    // Set fast charging and enable reading
    ret |= battery_set_fast_charge();
    if (ret)
    {
        printk("Battery: Failed to set fast charging (error %d)\n", ret);
        return ret;
    }

    ret |= battery_enable_read();
    if (ret)
    {
        printk("Battery: Failed to enable reading (error %d)\n", ret);
        return ret;
    }

    return 0;
}
```

## src/battery.h
```c
/*
 * Copyright 2024 Marcus Alexander Tjomsaas
 * SPDX-License-Identifier: Apache-2.0
 * 
 * Adapted for LiftSense project
 */

#ifndef __BATTERY_H__
#define __BATTERY_H__

#include <stdint.h>
#include <stdbool.h>

// Callback function type definitions
typedef void (*battery_charging_callback_t)(bool is_charging);
typedef void (*battery_sample_callback_t)(uint16_t millivolt);

/**
 * @brief Register a callback function that is executed every time the charging state changes.
 *
 * @retval 0 if successful. Negative errno number on error.
 */
int battery_register_charging_callback(battery_charging_callback_t callback);

/**
 * @brief Register a callback function that is executed every time a voltage sample is ready.
 *
 * @retval 0 if successful. Negative errno number on error.
 */
int battery_register_sample_callback(battery_sample_callback_t callback);

/**
 * @brief Set battery charging to fast charge (100mA).
 *
 * @retval 0 if successful. Negative errno number on error.
 */
int battery_set_fast_charge(void);

/**
 * @brief Set battery charging to slow charge (50mA).
 *
 * @retval 0 if successful. Negative errno number on error.
 */
int battery_set_slow_charge(void);

/**
 * @brief Get the current battery voltage in millivolts.
 *
 * @param[out] battery_millivolt Pointer where the battery voltage will be stored.
 *
 * @retval 0 if successful. Negative errno number on error.
 */
int battery_get_millivolt(uint16_t *battery_millivolt);

/**
 * @brief Calculate the battery percentage based on the voltage.
 *
 * @param[out] battery_percentage Pointer where the battery percentage will be stored.
 * @param[in] battery_millivolt Voltage reading to calculate the percentage from.
 *
 * @retval 0 if successful. Negative errno number on error.
 */
int battery_get_percentage(uint8_t *battery_percentage, uint16_t battery_millivolt);

/**
 * @brief Start periodic sampling of the battery voltage.
 *
 * @param[in] interval_ms Sampling interval in milliseconds.
 *
 * @retval 0 if successful. Negative errno number on error.
 *
 * @note Registered sample callbacks are called when a new sample is ready.
 */
int battery_start_sampling(uint32_t interval_ms);

/**
 * @brief Stop periodic sampling of the battery voltage.
 *
 * @retval 0 if successful. Negative errno number on error.
 */
int battery_stop_sampling(void);

/**
 * @brief Take a one-time battery voltage sample.
 *
 * @retval 0 if successful. Negative errno number on error.
 *
 * @note Registered sample callbacks are called when the sample is ready.
 */
int battery_sample_once(void);

/**
 * @brief Check if the battery is charging.
 *
 * @retval true if charging.
 */
bool battery_is_charging(void);

/**
 * @brief Initialize the battery management system.
 *
 * @retval 0 if successful. Negative errno number on error.
 */
int battery_init(void);

#endif
```

## src/ble.c
```c
#include "ble.h"
#include <zephyr/bluetooth/bluetooth.h>
#include <zephyr/bluetooth/gatt.h>
#include <zephyr/sys/printk.h>
#include <stdint.h>
#include <stddef.h>

static struct imu_packet imu_data;
static bool notify_enabled;

/* Battery level (0-100%) for standard Battery Service */
static uint8_t battery_level = 100;

/* BLE Service UUIDs */
/* LiftSense IMU Service: a0f1f001-5b25-4f91-a8e3-2c6d9f7b3e4a */
#define BT_UUID_IMU_SERVICE_VAL \
    BT_UUID_128_ENCODE(0xa0f1f001, 0x5b25, 0x4f91, 0xa8e3, 0x2c6d9f7b3e4a)

/* LiftSense IMU Data Characteristic: a0f1f002-5b25-4f91-a8e3-2c6d9f7b3e4a */
#define BT_UUID_IMU_CHAR_VAL \
    BT_UUID_128_ENCODE(0xa0f1f002, 0x5b25, 0x4f91, 0xa8e3, 0x2c6d9f7b3e4a)

static struct bt_uuid_128 imu_service_uuid = BT_UUID_INIT_128(BT_UUID_IMU_SERVICE_VAL);
static struct bt_uuid_128 imu_char_uuid = BT_UUID_INIT_128(BT_UUID_IMU_CHAR_VAL);

/* BLE notification callback */
static void ccc_cfg_changed(const struct bt_gatt_attr *attr, uint16_t value)
{
    notify_enabled = (value == BT_GATT_CCC_NOTIFY);
    printk("BLE notifications %s\n", notify_enabled ? "enabled" : "disabled");
}

/* BLE GATT Service Definition */
BT_GATT_SERVICE_DEFINE(imu_svc,
    BT_GATT_PRIMARY_SERVICE(&imu_service_uuid),
    BT_GATT_CHARACTERISTIC(&imu_char_uuid.uuid,
                          BT_GATT_CHRC_NOTIFY,
                          BT_GATT_PERM_NONE,
                          NULL, NULL, &imu_data),
    BT_GATT_CCC(ccc_cfg_changed,
               BT_GATT_PERM_READ | BT_GATT_PERM_WRITE)
);

/* BLE Advertisement Data */
static const struct bt_data ad[] = {
    BT_DATA_BYTES(BT_DATA_FLAGS, BT_LE_AD_GENERAL | BT_LE_AD_NO_BREDR),
    BT_DATA(BT_DATA_NAME_COMPLETE, CONFIG_BT_DEVICE_NAME, sizeof(CONFIG_BT_DEVICE_NAME) - 1),
};

/* Standard Battery Service (0x180F) */
BT_GATT_SERVICE_DEFINE(bas,
    BT_GATT_PRIMARY_SERVICE(BT_UUID_BAS),
    BT_GATT_CHARACTERISTIC(BT_UUID_BAS_BATTERY_LEVEL,
                          BT_GATT_CHRC_READ | BT_GATT_CHRC_NOTIFY,
                          BT_GATT_PERM_READ,
                          NULL, NULL, &battery_level),
    BT_GATT_CCC(NULL, BT_GATT_PERM_READ | BT_GATT_PERM_WRITE)
);

int ble_init(void)
{
    int err = bt_enable(NULL);
    if (err) {
        printk("BLE init failed (err %d)\n", err);
        return err;
    }

    printk("BLE initialized\n");
    return 0;
}

int ble_start_advertising(void)
{
    struct bt_le_adv_param adv_param = BT_LE_ADV_PARAM_INIT(
        BT_LE_ADV_OPT_CONN,
        BT_GAP_ADV_FAST_INT_MIN_1,
        BT_GAP_ADV_FAST_INT_MAX_1,
        NULL);
    
    int err = bt_le_adv_start(&adv_param, ad, ARRAY_SIZE(ad), NULL, 0);
    if (err) {
        printk("Advertising failed to start (err %d)\n", err);
        return err;
    }

    printk("BLE advertising started (LiftSense)\n");
    return 0;
}

int ble_notify_imu_data(const struct imu_packet *data)
{
    if (!notify_enabled) {
        return -1;  /* Not enabled */
    }
    
    /* Debug: Print BLE packet contents */
    printk("BLE TX: ts=%u ax=%d ay=%d az=%d gx=%d gy=%d gz=%d vert=%d\n",
           data->timestamp_ms,
           data->ax, data->ay, data->az,
           data->gx, data->gy, data->gz,
           data->vertical);
    
    /* Debug: Print raw bytes (little-endian on nRF52) */
    const uint8_t *bytes = (const uint8_t *)data;
    printk("BLE RAW [%zu bytes]: ", sizeof(*data));
    for (size_t i = 0; i < sizeof(*data); i++) {
        printk("%02x ", bytes[i]);
        if (i == 3 || i == 5 || i == 7 || i == 9 || i == 11 || i == 13 || i == 15) {
            printk("| ");  /* Field separator */
        }
    }
    printk("\n");
    
    return bt_gatt_notify(NULL, &imu_svc.attrs[1], data, sizeof(*data));
}

bool ble_is_notify_enabled(void)
{
    return notify_enabled;
}

int ble_update_battery_level(uint8_t level)
{
    if (level > 100) {
        level = 100;
    }
    
    battery_level = level;
    
    /* Notify if anyone is subscribed to battery level */
    return bt_gatt_notify(NULL, &bas.attrs[1], &battery_level, sizeof(battery_level));
}
```

## src/ble.h
```c
#ifndef BLE_H
#define BLE_H

#include "imu_packet.h"
#include <stdbool.h>

/* Initialize BLE stack */
int ble_init(void);

/* Start BLE advertising */
int ble_start_advertising(void);

/* Send IMU data notification to connected client */
int ble_notify_imu_data(const struct imu_packet *data);

/* Check if BLE notifications are enabled */
bool ble_is_notify_enabled(void);

/* Update battery level (0-100%) for Battery Service */
int ble_update_battery_level(uint8_t level);

#endif /* BLE_H */
```

## src/imu.c
```c
#include "imu.h"
#include <zephyr/kernel.h>
#include <zephyr/device.h>
#include <zephyr/sys/printk.h>
#include <math.h>

static struct sensor_value accel_x, accel_y, accel_z;
static struct sensor_value gyro_x, gyro_y, gyro_z;
static const struct device *imu_dev;
static imu_data_callback_t user_callback;

static void imu_trigger_handler(const struct device *dev,
                                const struct sensor_trigger *trig)
{
    /* Fetch and get accelerometer data */
    sensor_sample_fetch_chan(dev, SENSOR_CHAN_ACCEL_XYZ);
    sensor_channel_get(dev, SENSOR_CHAN_ACCEL_X, &accel_x);
    sensor_channel_get(dev, SENSOR_CHAN_ACCEL_Y, &accel_y);
    sensor_channel_get(dev, SENSOR_CHAN_ACCEL_Z, &accel_z);

    /* Fetch and get gyroscope data */
    sensor_sample_fetch_chan(dev, SENSOR_CHAN_GYRO_XYZ);
    sensor_channel_get(dev, SENSOR_CHAN_GYRO_X, &gyro_x);
    sensor_channel_get(dev, SENSOR_CHAN_GYRO_Y, &gyro_y);
    sensor_channel_get(dev, SENSOR_CHAN_GYRO_Z, &gyro_z);
    
    /* Call user callback if registered */
    if (user_callback) {
        user_callback(&accel_x, &accel_y, &accel_z,
                     &gyro_x, &gyro_y, &gyro_z);
    }
}

int imu_init(void)
{
    imu_dev = DEVICE_DT_GET_ONE(st_lsm6dsl);

    if (!device_is_ready(imu_dev)) {
        printk("LSM6DSL device not ready\n");
        return -1;
    }

    /* Set sampling frequency to 104 Hz */
    struct sensor_value odr_attr = {.val1 = 104, .val2 = 0};

    if (sensor_attr_set(imu_dev, SENSOR_CHAN_ACCEL_XYZ,
                        SENSOR_ATTR_SAMPLING_FREQUENCY, &odr_attr) < 0) {
        printk("Cannot set accel sampling frequency\n");
        return -1;
    }

    if (sensor_attr_set(imu_dev, SENSOR_CHAN_GYRO_XYZ,
                        SENSOR_ATTR_SAMPLING_FREQUENCY, &odr_attr) < 0) {
        printk("Cannot set gyro sampling frequency\n");
        return -1;
    }

    printk("IMU initialized at 104 Hz\n");
    return 0;
}

int imu_setup_trigger(imu_data_callback_t callback)
{
    user_callback = callback;
    
    /* Set up data-ready trigger */
    struct sensor_trigger trig = {
        .type = SENSOR_TRIG_DATA_READY,
        .chan = SENSOR_CHAN_ACCEL_XYZ
    };

    if (sensor_trigger_set(imu_dev, &trig, imu_trigger_handler) != 0) {
        printk("Could not set trigger\n");
        return -1;
    }

    printk("IMU trigger configured\n");
    return 0;
}

double imu_calibrate_gravity(double *gx, double *gy, double *gz)
{
    printk("Calibrating gravity vector...\n");
    k_sleep(K_MSEC(500));  /* Let sensor stabilize */
    
    /* Average several samples for gravity calibration */
    double sum_x = 0, sum_y = 0, sum_z = 0;
    for (int i = 0; i < 10; i++) {
        sum_x += sensor_value_to_double(&accel_x);
        sum_y += sensor_value_to_double(&accel_y);
        sum_z += sensor_value_to_double(&accel_z);
        k_sleep(K_MSEC(20));
    }
    
    *gx = sum_x / 10.0;
    *gy = sum_y / 10.0;
    *gz = sum_z / 10.0;
    
    double magnitude = sqrt((*gx) * (*gx) + (*gy) * (*gy) + (*gz) * (*gz));
    
    /* Normalize to unit vector */
    *gx /= magnitude;
    *gy /= magnitude;
    *gz /= magnitude;
    
    printk("Gravity calibrated: [%.2f, %.2f, %.2f] (mag: %.2f m/s²)\n",
           *gx, *gy, *gz, magnitude);
    
    return magnitude;
}

void imu_get_values(struct sensor_value *ax,
                    struct sensor_value *ay,
                    struct sensor_value *az,
                    struct sensor_value *gx,
                    struct sensor_value *gy,
                    struct sensor_value *gz)
{
    if (ax) *ax = accel_x;
    if (ay) *ay = accel_y;
    if (az) *az = accel_z;
    if (gx) *gx = gyro_x;
    if (gy) *gy = gyro_y;
    if (gz) *gz = gyro_z;
}
```

## src/imu.h
```c
#ifndef IMU_H
#define IMU_H

#include <zephyr/drivers/sensor.h>

/* IMU sensor callback type */
typedef void (*imu_data_callback_t)(struct sensor_value *accel_x,
                                    struct sensor_value *accel_y,
                                    struct sensor_value *accel_z,
                                    struct sensor_value *gyro_x,
                                    struct sensor_value *gyro_y,
                                    struct sensor_value *gyro_z);

/* Initialize IMU sensor */
int imu_init(void);

/* Set up IMU trigger with callback */
int imu_setup_trigger(imu_data_callback_t callback);

/* Calibrate gravity vector - returns magnitude */
double imu_calibrate_gravity(double *gx, double *gy, double *gz);

/* Get current sensor values */
void imu_get_values(struct sensor_value *accel_x,
                    struct sensor_value *accel_y,
                    struct sensor_value *accel_z,
                    struct sensor_value *gyro_x,
                    struct sensor_value *gyro_y,
                    struct sensor_value *gyro_z);

#endif /* IMU_H */
```

## src/imu_packet.h
```c
#ifndef IMU_PACKET_H
#define IMU_PACKET_H

#include <stdint.h>

/* IMU data packet structure for BLE transmission */
struct __attribute__((packed)) imu_packet {
    uint32_t timestamp_ms;
    int16_t ax;  /* Accelerometer X (m/s² × 1000) */
    int16_t ay;  /* Accelerometer Y (m/s² × 1000) */
    int16_t az;  /* Accelerometer Z (m/s² × 1000) */
    int16_t gx;  /* Gyroscope X (dps × 1000) */
    int16_t gy;  /* Gyroscope Y (dps × 1000) */
    int16_t gz;  /* Gyroscope Z (dps × 1000) */
    int16_t vertical;  /* Vertical acceleration relative to gravity (m/s² × 1000) */
};

#endif /* IMU_PACKET_H */
```

## src/sensor_math.c
```c
#include "sensor_math.h"
#include <math.h>

#ifndef M_PI
#define M_PI 3.14159265358979323846
#endif

/* Gravity vector (normalized direction and magnitude) */
static double gravity_x, gravity_y, gravity_z;
static double gravity_magnitude;

/* Complementary filter - tracks current gravity direction in sensor frame */
static double grav_est_x, grav_est_y, grav_est_z;

void sensor_math_init(double gx, double gy, double gz, double magnitude)
{
    gravity_x = gx;
    gravity_y = gy;
    gravity_z = gz;
    gravity_magnitude = magnitude;
    
    /* Initialize gravity estimate */
    grav_est_x = gx;
    grav_est_y = gy;
    grav_est_z = gz;
}

void sensor_math_update_filter(double ax, double ay, double az,
                               double gx, double gy, double gz,
                               double dt)
{
    /* Filter coefficient (0.98 = trust gyro 98%, accel 2%) */
    const double alpha = 0.98;
    
    /* Convert gyro from deg/s to rad/s */
    double gx_rad = gx * M_PI / 180.0;
    double gy_rad = gy * M_PI / 180.0;
    double gz_rad = gz * M_PI / 180.0;
    
    /* Predict gravity direction by rotating current estimate with gyro */
    /* Small angle approximation: rotate gravity vector by -gyro * dt */
    double gx_dt = gx_rad * dt;
    double gy_dt = gy_rad * dt;
    double gz_dt = gz_rad * dt;
    
    /* Cross product: gravity_new = gravity - (gyro × gravity) * dt */
    double pred_x = grav_est_x - (gy_dt * grav_est_z - gz_dt * grav_est_y);
    double pred_y = grav_est_y - (gz_dt * grav_est_x - gx_dt * grav_est_z);
    double pred_z = grav_est_z - (gx_dt * grav_est_y - gy_dt * grav_est_x);
    
    /* Normalize prediction */
    double pred_mag = sqrt(pred_x * pred_x + pred_y * pred_y + pred_z * pred_z);
    if (pred_mag > 0.1) {
        pred_x /= pred_mag;
        pred_y /= pred_mag;
        pred_z /= pred_mag;
    }
    
    /* Correct with accelerometer (normalized) */
    double accel_mag = sqrt(ax * ax + ay * ay + az * az);
    double accel_weight = alpha;
    
    /* If total acceleration is close to 1g, trust accelerometer more */
    if (accel_mag > 8.0 && accel_mag < 12.0) {
        /* Near 1g - likely stationary or constant velocity */
        accel_weight = 0.95;  /* Trust accel more */
    }
    
    if (accel_mag > 0.1) {
        double accel_x_norm = ax / accel_mag;
        double accel_y_norm = ay / accel_mag;
        double accel_z_norm = az / accel_mag;
        
        /* Complementary filter: blend gyro prediction with accel correction */
        grav_est_x = accel_weight * pred_x + (1.0 - accel_weight) * accel_x_norm;
        grav_est_y = accel_weight * pred_y + (1.0 - accel_weight) * accel_y_norm;
        grav_est_z = accel_weight * pred_z + (1.0 - accel_weight) * accel_z_norm;
    } else {
        /* High acceleration - just use gyro prediction */
        grav_est_x = pred_x;
        grav_est_y = pred_y;
        grav_est_z = pred_z;
    }
    
    /* Normalize final estimate */
    double est_mag = sqrt(grav_est_x * grav_est_x + 
                         grav_est_y * grav_est_y + 
                         grav_est_z * grav_est_z);
    if (est_mag > 0.1) {
        grav_est_x /= est_mag;
        grav_est_y /= est_mag;
        grav_est_z /= est_mag;
    }
}

double sensor_math_calc_vertical(double ax, double ay, double az)
{
    /* Dot product gives total acceleration along gravity direction */
    double accel_along_gravity = (ax * grav_est_x + ay * grav_est_y + az * grav_est_z);
    
    /* Subtract gravity magnitude to get net vertical acceleration */
    return accel_along_gravity - gravity_magnitude;
}

void sensor_math_get_gravity_estimate(double *gx, double *gy, double *gz)
{
    if (gx) *gx = grav_est_x;
    if (gy) *gy = grav_est_y;
    if (gz) *gz = grav_est_z;
}

int16_t sensor_to_milli_int16(const struct sensor_value *v)
{
    return (int16_t)(v->val1 * 1000 + v->val2 / 1000);
}
```

## src/sensor_math.h
```c
#ifndef SENSOR_MATH_H
#define SENSOR_MATH_H

#include <zephyr/drivers/sensor.h>

/* Initialize sensor math module with initial gravity vector */
void sensor_math_init(double gx, double gy, double gz, double magnitude);

/* Update complementary filter with new sensor readings */
void sensor_math_update_filter(double ax, double ay, double az,
                               double gx, double gy, double gz,
                               double dt);

/* Calculate vertical acceleration relative to gravity */
double sensor_math_calc_vertical(double ax, double ay, double az);

/* Get current gravity estimate */
void sensor_math_get_gravity_estimate(double *gx, double *gy, double *gz);

/* Convert sensor_value to int16 millis for BLE transmission */
int16_t sensor_to_milli_int16(const struct sensor_value *v);

#endif /* SENSOR_MATH_H */
```
